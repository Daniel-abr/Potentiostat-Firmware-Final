/*
 * drivers/renderer.h — thin drawing abstraction over the DFRobot Fermion
 * 1.8" TFT (ST7735, 128x160).
 *
 * This is the ONE place that talks to Adafruit_GFX/Adafruit_ST7735
 * directly. Screens (screens/*.h) only ever call methods on `Renderer` —
 * they never touch the display library, so the AD5941 driver, SD/file
 * logic, and screen/state-machine logic all stay decoupled from exactly
 * which TFT library or panel is wired up.
 *
 * Two families of methods:
 *   - Generic primitives (clear, printLine, progressBar, modalBox, gfx())
 *     used by Boot, menus, and the stubbed screens.
 *   - Sweep-specific methods (drawChrome, updateReadout, sweepStart/
 *     sweepPoint/sweepDone) carried over from the original dashboard
 *     mock — used by the Home screen while a scan is running.
 *
 * Icons are simple drawn glyphs (arcs/rects), not the exact pixel-art
 * bitmaps from the reference UI mock — swap in real bitmaps later with
 * Adafruit_GFX's drawBitmap() + arrays generated by a tool like
 * image2cpp if you want an exact visual match to potentiostat UI
 * design.jpg.
 *
 * Shares its SPI bus with the SD card (SDCS is a separate CS pin on the
 * same MOSI/MISO/SCLK) — construct with a pointer to a bus that's already
 * had begin() called on it in main.cpp.
 */
#pragma once
#include <Arduino.h>
#include <SPI.h>
#include <Adafruit_GFX.h>
#include <Adafruit_ST7735.h>
#include <qrcode.h> // item I — ricmoo/QRCode, small/no-dynamic-allocation, embedded-friendly

// Panel is 128x160 in portrait; rotation 1 gives 160x128 landscape.
#define TFT_W 160
#define TFT_H 128

// This panel (DFRobot Fermion 1.8", ST7735S IPS) has a controller GRAM a few
// pixels larger than the 128x160 visible area (typically 132x162), so the
// window has to start at a small column/row offset. With no offset the
// picture sits shifted up-and-left and the leftover GRAM shows as random
// coloured pixels along the right and bottom edges — which is what this
// panel did before the offset below was added. (2,1) is the usual value for
// 128x160 ST7735S panels; if a fringe remains, tune it live over serial with
// "tftoffset <col> <row>" (draws a border test pattern each time) and copy
// the values that give a clean border back into these two defines.
#define TFT_INITR_TAB INITR_BLACKTAB // try INITR_GREENTAB / INITR_REDTAB if colours are wrong
#define TFT_OFFSET_X 2 // GRAM column offset (Adafruit "col")
#define TFT_OFFSET_Y 1 // GRAM row offset (Adafruit "row")

// Pixel colors matching the 8-bit reference palette (RGB565).
#define COLOR_BG      ST77XX_BLACK
#define COLOR_ORANGE  0xFD20 // current readouts
#define COLOR_CYAN    ST77XX_CYAN // voltage readouts
#define COLOR_GREEN   ST77XX_GREEN // graph trace / progress / OK
#define COLOR_RED     ST77XX_RED // warnings / errors / danger
#define COLOR_GREY    0x39C7 // inactive / secondary text
#define COLOR_WHITE   ST77XX_WHITE

// Item D/E — default current-axis range for the live trace (nA), used only
// as the starting point when no better estimate is available (fixed-RTIA
// sweeps with no auto-range probe, or the simulated/demo data path) — the
// actual active range is now dynamic (Renderer::_graphMinNa/_graphMaxNa,
// set via sweepStart()/applyGraphRange()) and expands mid-sweep if a
// reading falls outside it. Kept as named constants (not folded into
// Renderer) so main.cpp can reference the same default when deciding how
// to seed a sweep that has no auto-range probe estimate to seed from.
#define GRAPH_I_MIN_NA -20.0f
#define GRAPH_I_MAX_NA 300.0f

// Adafruit_ST77xx::setColRowStart() (the GRAM window offset) is protected in
// the library, so expose it through this thin subclass rather than editing
// the vendored library code.
class TftPanel : public Adafruit_ST7735 {
public:
  TftPanel(SPIClass *spi, int8_t cs, int8_t dc, int8_t rst)
    : Adafruit_ST7735(spi, cs, dc, rst) {}
  using Adafruit_ST77xx::setColRowStart;
};

class Renderer {
public:
  Renderer(SPIClass *spi, int8_t cs, int8_t dc, int8_t rst)
    : _gfx(spi, cs, dc, rst) {}

  // Hardware init only — does NOT draw anything, so Boot/Home decide what
  // the very first frame looks like.
  void begin() {
    _gfx.initR(TFT_INITR_TAB); // if colors/edges look wrong, see the TFT_* defines above
    applyGeometry();
  }

  // Re-applies the GRAM offset + orientation and clears the screen. begin()
  // uses the TFT_OFFSET_* defaults; the serial "tftoffset" command calls this
  // to try other values without reflashing.
  void setOffsets(int col, int row) {
    _offCol = col;
    _offRow = row;
    applyGeometry();
  }

  // Border test pattern for tuning the offset: a clean 1px white frame on
  // all four edges with no stray pixels outside it means the offset is right.
  void testPattern() {
    _gfx.fillScreen(COLOR_BG);
    _gfx.drawRect(0, 0, TFT_W, TFT_H, COLOR_WHITE);
    _gfx.drawRect(1, 1, TFT_W - 2, TFT_H - 2, COLOR_RED);
    _gfx.drawLine(0, 0, TFT_W - 1, TFT_H - 1, COLOR_GREY);
    _gfx.drawLine(TFT_W - 1, 0, 0, TFT_H - 1, COLOR_GREY);
    char buf[24];
    snprintf(buf, sizeof(buf), "col=%d row=%d", _offCol, _offRow);
    centeredTitle(buf, TFT_H / 2 - 4, COLOR_WHITE, 1);
  }

private:
  void applyGeometry() {
    _gfx.setColRowStart(_offCol, _offRow); // must come before setRotation()
    // Rotation 3, not 1: rotation 1 rendered upside down on this panel (a
    // 180° flip, not sideways). For INITR_BLACKTAB the library sends MADCTL
    // 0xA0 (MY|MV|RGB) for rotation 1 and 0x60 (MX|MV|RGB) for rotation 3 —
    // same MV (still 160x128 landscape) and same RGB order bit, only the
    // row/column address order (MY/MX) differs, which is exactly the 180° flip.
    _gfx.setRotation(3);
    _gfx.fillScreen(COLOR_BG);
  }

public:
  // ------------------------------------------------------------------
  // Generic primitives — used by Boot, menu-style screens, and stubs.
  // ------------------------------------------------------------------

  void clear() { _gfx.fillScreen(COLOR_BG); }

  // Prints one line of text at a fixed 10px-tall row, 0-indexed from the
  // top of the screen. Good enough for lists/logs; screens needing custom
  // layout can drop to gfx() directly.
  void printLine(int lineIndex, const char *text, uint16_t color, uint8_t textSize = 1) {
    int y = 2 + lineIndex * 10;
    _gfx.fillRect(0, y, TFT_W, 10, COLOR_BG);
    _gfx.setTextColor(color);
    _gfx.setTextSize(textSize);
    _gfx.setCursor(2, y);
    _gfx.print(text);
  }

  // A selectable menu row on the same 10px grid as printLine(): a selected
  // row gets a grey bar, the row currently being edited an orange one.
  // `text` should fit in ~26 characters (size-1 text wraps past the edge).
  void menuRow(int lineIndex, const char *text, bool selected, bool editing) {
    int y = 2 + lineIndex * 10;
    uint16_t bg = editing ? COLOR_ORANGE : (selected ? COLOR_GREY : COLOR_BG);
    uint16_t fg = editing ? COLOR_BG : COLOR_WHITE;
    _gfx.fillRect(0, y, TFT_W, 10, bg);
    _gfx.setTextColor(fg);
    _gfx.setTextSize(1);
    _gfx.setCursor(2, y);
    _gfx.print(text);
  }

  // Draws an underline beneath character `col` of a line printed with
  // printLine()/menuRow() (6px per character, text starting at x=2) — used
  // as a text-entry cursor.
  void underlineChar(int lineIndex, int col, uint16_t color) {
    int y = 2 + lineIndex * 10 + 9;
    int x = 2 + col * 6;
    _gfx.drawFastHLine(x, y, 5, color);
  }

  // Plain text at an arbitrary pixel position, no background clear.
  void printAt(int x, int y, const char *text, uint16_t color, uint8_t textSize = 1) {
    _gfx.setTextColor(color);
    _gfx.setTextSize(textSize);
    _gfx.setCursor(x, y);
    _gfx.print(text);
  }

  void fillRegion(int x, int y, int w, int h, uint16_t color) { _gfx.fillRect(x, y, w, h, color); }
  void drawFrame(int x, int y, int w, int h, uint16_t color) { _gfx.drawRect(x, y, w, h, color); }

  // Item I — full-panel QR code: dark modules on a white background
  // (inverted from this app's normal black theme, deliberately, to match
  // standard QR contrast/scanability), quiet zone >=3 modules on every
  // side (phones need this margin to reliably lock on), module size
  // computed from the actual screen dimensions so the code plus its quiet
  // zone fills the display as large as possible without clipping. Tries
  // increasing QR versions (more modules, more data capacity) until one
  // successfully encodes `text`, rather than assuming a fixed version — a
  // short URL and a long WIFI: join string need very different sizes.
  // Returns false (and prints an error instead of a code) if even the
  // largest version tried can't fit the text.
  bool drawQrCode(const char *text) {
    static const uint8_t kMaxVersion = 10;    // 57x57 modules, plenty for a WIFI: join string at ECC_LOW
    static const int kQuietZoneModules = 3;
    uint8_t buf[480]; // >= qrcode_getBufferSize(kMaxVersion) (407 bytes at version 10)

    QRCode qrcode;
    uint8_t version = 0;
    for (uint8_t v = 1; v <= kMaxVersion; v++) {
      if (qrcode_initText(&qrcode, buf, v, ECC_LOW, text) == 0) {
        version = v;
        break;
      }
    }

    _gfx.fillScreen(COLOR_WHITE);
    if (version == 0) {
      _gfx.setTextColor(COLOR_RED);
      _gfx.setTextSize(1);
      _gfx.setCursor(4, 4);
      _gfx.print("QR: text too long");
      return false;
    }

    int gridModules = qrcode.size;
    int totalModules = gridModules + 2 * kQuietZoneModules;
    int moduleSize = min(TFT_W, TFT_H) / totalModules;
    if (moduleSize < 1) moduleSize = 1; // degrade gracefully rather than draw nothing
    int totalPx = totalModules * moduleSize;
    int x0 = (TFT_W - totalPx) / 2;
    int y0 = (TFT_H - totalPx) / 2;

    for (int y = 0; y < gridModules; y++) {
      for (int x = 0; x < gridModules; x++) {
        if (qrcode_getModule(&qrcode, x, y)) {
          int px = x0 + (kQuietZoneModules + x) * moduleSize;
          int py = y0 + (kQuietZoneModules + y) * moduleSize;
          _gfx.fillRect(px, py, moduleSize, moduleSize, ST77XX_BLACK);
        }
      }
    }
    return true;
  }
  void drawLine(int x0, int y0, int x1, int y1, uint16_t color) { _gfx.drawLine(x0, y0, x1, y1, color); }

  void centeredTitle(const char *text, int y, uint16_t color, uint8_t textSize = 2) {
    int16_t x1, y1;
    uint16_t w, h;
    _gfx.setTextSize(textSize);
    _gfx.getTextBounds(text, 0, 0, &x1, &y1, &w, &h);
    int x = (TFT_W - w) / 2;
    _gfx.setTextColor(color);
    _gfx.setCursor(x, y);
    _gfx.print(text);
  }

  void progressBar(int x, int y, int w, int h, int pct, uint16_t color) {
    _gfx.drawRect(x, y, w, h, COLOR_GREY);
    int fillW = (w - 2) * constrain(pct, 0, 100) / 100;
    _gfx.fillRect(x + 1, y + 1, max(0, fillW), h - 2, color);
  }

  // A centered modal box with a title + up to two message lines — used
  // for the mid-sweep "stop confirm" prompt and similar interruptions.
  void modalBox(const char *title, const char *line1, const char *line2, uint16_t accent) {
    int w = 128, h = 56;
    int x = (TFT_W - w) / 2, y = (TFT_H - h) / 2;
    _gfx.fillRect(x, y, w, h, COLOR_BG);
    _gfx.drawRect(x, y, w, h, accent);
    _gfx.drawRect(x + 1, y + 1, w - 2, h - 2, accent);
    _gfx.setTextSize(1);
    _gfx.setTextColor(accent);
    _gfx.setCursor(x + 6, y + 6);
    _gfx.print(title);
    _gfx.setTextColor(COLOR_WHITE);
    _gfx.setCursor(x + 6, y + 24);
    _gfx.print(line1);
    _gfx.setCursor(x + 6, y + 38);
    _gfx.print(line2);
  }

  // Escape hatch for screens that need something bespoke this API doesn't
  // cover yet. Prefer adding a named method above over reaching for this
  // from screen code, so drawing logic stays in one place.
  Adafruit_ST7735 &gfx() { return _gfx; }

  // ------------------------------------------------------------------
  // Sweep-specific — used by the Home screen (live DPV measurement).
  // ------------------------------------------------------------------

  // rtiaText is a short pre-formatted string (e.g. "10kR") — Renderer stays
  // a dumb drawing layer, so the ohms-to-string/unit formatting is the
  // caller's job (see main.cpp's ctxRtiaText()), not this file's.
  void drawChrome(const char *technique, bool wifiUp, bool sdUp, int batteryPct, const char *rtiaText) {
    _gfx.fillRect(0, 0, TFT_W, 12, COLOR_BG);
    _gfx.setTextColor(COLOR_WHITE);
    _gfx.setTextSize(1);
    _gfx.setCursor(2, 2);
    _gfx.print(technique);

    // RTIA range in use — sits in the gap between the technique name and
    // the Wi-Fi icon (x~20 to x~100), which was previously empty.
    _gfx.setTextColor(COLOR_GREY);
    _gfx.setCursor(42, 2);
    _gfx.print(rtiaText);

    // Wi-Fi glyph: the standard signal-fan symbol — a dot with nested arcs
    // opening upward above it, not concentric full circles. Built from
    // Adafruit_GFX's drawCircleHelper() quarter-circle primitive; its
    // cornername quadrant bits were verified directly against the vendored
    // library source (Adafruit_GFX.cpp) rather than assumed: 0x1 = upper-left
    // quadrant, 0x2 = upper-right, so 0x1|0x2 draws the upper half of the
    // circle — an arc curving away from the dot, matching the icon convention.
    int wx = 108, wy = 9;
    uint16_t wc = wifiUp ? COLOR_CYAN : COLOR_GREY;
    _gfx.fillCircle(wx, wy, 1, wc);
    _gfx.drawCircleHelper(wx, wy, 3, 0x3, wc);
    _gfx.drawCircleHelper(wx, wy, 6, 0x3, wc);
    _gfx.drawCircleHelper(wx, wy, 8, 0x3, wc);

    // SD glyph: small filled rounded rect
    int sx = 126, sy = 2;
    uint16_t sc = sdUp ? COLOR_GREEN : COLOR_GREY;
    _gfx.fillRoundRect(sx, sy, 8, 10, 2, sc);

    // Battery glyph: outline + fill proportional to batteryPct
    int bx = 140, by = 3;
    uint16_t bc = batteryPct < 20 ? COLOR_RED : COLOR_WHITE;
    _gfx.drawRect(bx, by, 16, 8, bc);
    _gfx.fillRect(bx + 16, by + 2, 2, 4, bc); // terminal nub
    int fillW = max(1, (int)(12 * (batteryPct / 100.0f)));
    _gfx.fillRect(bx + 2, by + 2, fillW, 4, bc);
  }

  void updateReadout(float voltage, float current_nA) {
    _gfx.fillRect(0, 13, TFT_W, 22, COLOR_BG);

    // Current's width varies a lot (e.g. "1.2nA" vs "-1234.5nA" through a
    // mismatched dummy load, or several uA on a real electroactive sample),
    // so a fixed x=90 before this fix could run straight into the voltage
    // digits on a wide reading. Two defenses now (confirmed with the
    // user): (1) switch to uA once |current| >= 1000nA so the string
    // itself stays short — 2 decimal places if the combined row still
    // fits the 160px panel, dropping to 1 only if it doesn't — and (2)
    // measure every field's actual width and derive vx from that, so
    // position math can't clamp into an overlap by construction (no
    // hardcoded ceiling).
    bool useUa = fabsf(current_nA) >= 1000.0f;
    float curVal = useUa ? current_nA / 1000.0f : current_nA;
    const char *curUnit = useUa ? "uA" : "nA";
    int curDecimals = useUa ? 2 : 1;

    char voltBuf[12];
    snprintf(voltBuf, sizeof(voltBuf), "%s%.3f", voltage >= 0 ? "+" : "", voltage);

    int16_t bx, by;
    uint16_t numW, numH, suffixW, suffixH, voltW, voltH, vSuffixW, vSuffixH;
    _gfx.setTextSize(1);
    _gfx.getTextBounds("V", 0, 0, &bx, &by, &vSuffixW, &vSuffixH);

    char curNumBuf[12];
    for (;;) {
      snprintf(curNumBuf, sizeof(curNumBuf), "%.*f", curDecimals, curVal);
      _gfx.setTextSize(2);
      _gfx.getTextBounds(curNumBuf, 2, 16, &bx, &by, &numW, &numH);
      _gfx.getTextBounds(voltBuf, 0, 0, &bx, &by, &voltW, &voltH);
      _gfx.setTextSize(1);
      _gfx.getTextBounds(curUnit, 0, 0, &bx, &by, &suffixW, &suffixH);
      int totalW = 2 + (int)numW + (int)suffixW + 6 + (int)voltW + (int)vSuffixW;
      if (totalW <= TFT_W || curDecimals == 0) break;
      curDecimals--;
    }

    _gfx.setTextColor(COLOR_ORANGE);
    _gfx.setTextSize(2);
    _gfx.setCursor(2, 16);
    _gfx.print(curNumBuf);
    _gfx.setTextSize(1);
    _gfx.print(curUnit);

    int vx = max(90, 2 + (int)numW + (int)suffixW + 6);
    // Last-resort safety net (should already fit via the decimal fallback
    // above) so the voltage field never draws past the panel edge.
    vx = min(vx, TFT_W - (int)voltW - (int)vSuffixW - 2);

    _gfx.setTextColor(COLOR_CYAN);
    _gfx.setTextSize(2);
    _gfx.setCursor(vx, 16);
    _gfx.print(voltBuf);
    _gfx.setTextSize(1);
    _gfx.print("V");
  }

  // graphMinNa/graphMaxNa seed the Y-axis range for this sweep (item D/E —
  // main.cpp computes these from the auto-range probe's peak estimate when
  // one is available, or GRAPH_I_MIN_NA/MAX_NA otherwise; see
  // computeExpandedRange()/applyGraphRange() for how it grows mid-sweep).
  void sweepStart(const char *technique, float graphMinNa, float graphMaxNa) {
    strncpy(_technique, technique, sizeof(_technique) - 1);
    _technique[sizeof(_technique) - 1] = '\0';
    _graphMinNa = graphMinNa;
    _graphMaxNa = graphMaxNa;
    _lastPx = -1;
    _lastPy = -1;
    _gfx.fillRect(0, 36, TFT_W, 68, COLOR_BG);
    drawGrid();
    drawAxisLabels();
    drawChrome(_technique, _wifiUp, _sdUp, _batteryPct, _rtiaText);
  }

  void sweepPoint(float v, float i_nA, float startV, float endV, int progressPct,
                  const char *filename, unsigned long elapsedSec) {
    updateReadout(v, i_nA);
    drawTraceLine(v, i_nA, startV, endV);
    progressBar(GRAPH_X0, GRAPH_Y0 + GRAPH_H + 4, GRAPH_W, 5, progressPct, COLOR_GREEN);
    drawFooter(filename, elapsedSec);
  }

  void sweepDone() {
    drawChrome(_technique, _wifiUp, _sdUp, _batteryPct, _rtiaText);
  }

  // ---- Item D/E: dynamic graph Y-axis range ----
  // Policy (when to expand, whether it's affordable this tick, replaying
  // the point history) lives in main.cpp, which owns the sweep's captured
  // points (sweepBuffer) and timing context — these are just the
  // mechanical primitives: check/compute/apply/redraw-one-segment.
  float graphMinNa() const { return _graphMinNa; }
  float graphMaxNa() const { return _graphMaxNa; }
  bool graphNeedsExpand(float i_nA) const { return i_nA < _graphMinNa || i_nA > _graphMaxNa; }

  // Geometric growth (>=2x the old span) around the current range's
  // midpoint, sized to cover i_nA with margin — confirmed with the user:
  // a trace climbing steadily toward a peak should settle after a handful
  // of expansions, not retrigger a redraw on nearly every point the way an
  // exact-fit-plus-small-margin growth would.
  void computeExpandedRange(float i_nA, float &outMin, float &outMax) const {
    float span = _graphMaxNa - _graphMinNa;
    if (span < 1.0f) span = 1.0f;
    float mid = (_graphMinNa + _graphMaxNa) * 0.5f;
    float neededHalfSpan = max(fabsf(i_nA - mid), span * 0.5f) * 1.2f; // 1.2x margin over the point itself
    float newSpan = max(span * 2.0f, neededHalfSpan * 2.0f); // >=2x old span, whichever is bigger
    outMin = mid - newSpan * 0.5f;
    outMax = mid + newSpan * 0.5f;
  }

  // Sets the active range, clears+redraws the grid and axis labels, and
  // resets trace continuity (same as sweepStart()) — caller replots every
  // already-captured point via drawTraceLine() afterward, in order.
  void applyGraphRange(float minNa, float maxNa) {
    _graphMinNa = minNa;
    _graphMaxNa = maxNa;
    _lastPx = -1;
    _lastPy = -1;
    _gfx.fillRect(GRAPH_X0, GRAPH_Y0, GRAPH_W, GRAPH_H, COLOR_BG);
    drawGrid();
    drawAxisLabels();
  }

  // Just the trace line segment (extracted out of sweepPoint() so it can
  // be reused both for live plotting and for replaying the whole buffer
  // after applyGraphRange()).
  void drawTraceLine(float v, float i_nA, float startV, float endV) {
    int px = mapf(v, startV, endV, GRAPH_X0, GRAPH_X0 + GRAPH_W);
    int py = mapf(i_nA, _graphMinNa, _graphMaxNa, GRAPH_Y0 + GRAPH_H, GRAPH_Y0);
    py = constrain(py, GRAPH_Y0, GRAPH_Y0 + GRAPH_H);
    if (_lastPx >= 0) {
      _gfx.drawLine(_lastPx, _lastPy, px, py, COLOR_GREEN);
    }
    _lastPx = px;
    _lastPy = py;
  }

  void setStatus(bool wifiUp, bool sdUp, int batteryPct, const char *rtiaText) {
    _wifiUp = wifiUp;
    _sdUp = sdUp;
    _batteryPct = batteryPct;
    strncpy(_rtiaText, rtiaText, sizeof(_rtiaText) - 1);
    _rtiaText[sizeof(_rtiaText) - 1] = '\0';
  }

private:
  static const int GRAPH_X0 = 4;
  static const int GRAPH_Y0 = 38;
  static const int GRAPH_W = 150;
  static const int GRAPH_H = 62;

  void drawGrid() {
    _gfx.drawRect(GRAPH_X0, GRAPH_Y0, GRAPH_W, GRAPH_H, COLOR_GREY);
    for (int x = GRAPH_X0; x < GRAPH_X0 + GRAPH_W; x += 15) {
      for (int y = GRAPH_Y0; y < GRAPH_Y0 + GRAPH_H; y += 6) {
        _gfx.drawPixel(x, y, 0x2965);
      }
    }
  }

  // Item D/E — numeric min/max labels for the current Y-axis range,
  // overlaid in the plot box's own top-right/bottom-right corners (a
  // 160px panel has no room for a separate margin column without
  // shrinking the trace area further). Each is background-filled before
  // redrawing — same "clear bounding box before printing" approach as
  // updateReadout()/drawFooter() — so a range change (expansion) never
  // leaves stale digits visible, and a digit count change (e.g. "99" ->
  // "123") never overlaps the trace drawn up to that corner.
  void drawAxisLabels() {
    char buf[8];
    _gfx.setTextSize(1);
    _gfx.setTextColor(COLOR_GREY);

    snprintf(buf, sizeof(buf), "%.0f", _graphMaxNa);
    int w = (int)strlen(buf) * 6;
    _gfx.fillRect(GRAPH_X0 + GRAPH_W - w - 2, GRAPH_Y0 + 1, w + 2, 8, COLOR_BG);
    _gfx.setCursor(GRAPH_X0 + GRAPH_W - w - 1, GRAPH_Y0 + 1);
    _gfx.print(buf);

    snprintf(buf, sizeof(buf), "%.0f", _graphMinNa);
    w = (int)strlen(buf) * 6;
    _gfx.fillRect(GRAPH_X0 + GRAPH_W - w - 2, GRAPH_Y0 + GRAPH_H - 9, w + 2, 8, COLOR_BG);
    _gfx.setCursor(GRAPH_X0 + GRAPH_W - w - 1, GRAPH_Y0 + GRAPH_H - 9);
    _gfx.print(buf);
  }

  void drawFooter(const char *filename, unsigned long elapsedSec) {
    int y = GRAPH_Y0 + GRAPH_H + 12;
    _gfx.fillRect(0, y, TFT_W, 10, COLOR_BG);
    _gfx.setTextColor(COLOR_WHITE);
    _gfx.setTextSize(1);
    _gfx.setCursor(2, y);

    // "FILE:" + filename used to be printed at full length regardless of
    // how long the label was — a longer sample label (up to
    // SweepLimits::kLabelMax) pushed "FILE:<label>_NN.csv" past x=120,
    // straight into the elapsed-timer field drawn there. Truncate to
    // whatever fits in the space actually left before the timer (6px/char
    // at size 1), so the two can never collide.
    static const int kTimerX = TFT_W - 40;
    static const int kGapPx = 4;
    int maxChars = (kTimerX - kGapPx - 2) / 6; // 2 = left margin the cursor starts at
    char buf[40];
    snprintf(buf, sizeof(buf), "FILE:%s", filename);
    int len = (int)strlen(buf);
    if (len > maxChars) {
      // Elide with ".." so it's visibly truncated rather than just cut off.
      if (maxChars > 2) snprintf(buf + maxChars - 2, sizeof(buf) - (maxChars - 2), "..");
      buf[maxChars] = '\0';
    }
    _gfx.print(buf);

    char timeBuf[8];
    snprintf(timeBuf, sizeof(timeBuf), "%02lu:%02lu", elapsedSec / 60, elapsedSec % 60);
    _gfx.setCursor(kTimerX, y);
    _gfx.print(timeBuf);
  }

  int mapf(float x, float inMin, float inMax, int outMin, int outMax) {
    if (inMax == inMin) return outMin;
    return (int)((x - inMin) * (outMax - outMin) / (inMax - inMin) + outMin);
  }

  TftPanel _gfx;
  int _offCol = TFT_OFFSET_X, _offRow = TFT_OFFSET_Y;
  char _technique[8] = "DPV";
  int _lastPx = -1, _lastPy = -1;
  float _graphMinNa = GRAPH_I_MIN_NA, _graphMaxNa = GRAPH_I_MAX_NA; // item D/E — dynamic now
  bool _wifiUp = false, _sdUp = false;
  int _batteryPct = 100;
  char _rtiaText[12] = "?";
};
